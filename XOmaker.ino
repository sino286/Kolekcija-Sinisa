#include <SPI.h>
#include <Gamebuino.h>
Gamebuino gb;
//Spriteovi:
//moj logo
const byte sino_logo[] PROGMEM = {88,48,
B11111111,B11111111,B11111111,B11111111,B11111111,B11111111,B11111111,B11111111,B11111111,B11111111,B11110000,
B11111111,B11111111,B11111111,B11111111,B11111111,B11111111,B11111111,B11111111,B11111111,B11111111,B11110000,
B11111111,B11111111,B11111111,B11111111,B11111111,B11111111,B11111111,B11111111,B11111111,B11111111,B11110000,
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B11111111,B11111111,B11111111,B11111111,B11111111,B11111111,B11111111,B11111111,B11111111,B11111111,B11110000,
};

//logo igre
const byte XO_logo[] PROGMEM = {64,32,
B00000000,B00000000,B00000000,B00000000,B00000000,B00000000,B00000000,B00000000,
B00000000,B00000000,B01100000,B00000000,B00011000,B00000000,B00000000,B00000000,
B00000000,B00000000,B01110000,B00000000,B00111000,B00000000,B00000000,B00000000,
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B00000000,B00000000,B00000000,B00000000,B00111111,B00000000,B00000000,B00000000,
};

//mreza za igru
const byte mreza[] PROGMEM = {84,48,
B00000000,B00000000,B00000000,B00000000,B00000000,B00000000,B00000000,B00000000,B00000000,B00000000,B00000000,
B00000000,B00000001,B10000000,B00000001,B10000000,B00000000,B00000000,B00000000,B00000000,B00000000,B00000000,
B00000000,B00000001,B10000000,B00000001,B10000000,B00000000,B00000000,B00000000,B00000000,B00000000,B00000000,
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B00000000,B00000000,B00000000,B00000000,B00000000,B00000000,B00000000,B00000000,B00000000,B00000000,B00000000,
};

//znak X kao oznaka AI igraca
const byte znak_X[] PROGMEM = {12,12,
B10000000,B00010000,
B01000000,B00100000,
B00100000,B01000000,
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B10000000,B00010000,
};

//znak O kao oznaka igrača
const byte znak_O[] PROGMEM = {12,12,
B00011111,B10000000,
B00100000,B01000000,
B01000000,B00100000,
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B00011111,B10000000,
};

//funkcija wait kao alternativa za funkciju delay()
void wait(int frames){
  frames += gb.frameCount;
  gb.display.persistence = true;
  while(gb.frameCount < frames){
    while(!gb.update());
    }
  gb.display.persistence = false;
}

//pretvara koordinate selektora polja u indeks polja u koje se sprema stanje ploče za igru
int pronadi_poziciju(int pozicije[9][2], int x, int y){
    for(int i = 0; i < 9; ++i){
        if (pozicije[i][0] == x && pozicije[i][1] == y){
            return i;
          }
      }
    return 0;
}

//provjerava uvjet za pobjedu za oznaku igraca znak (1 - O , 2 - X)
bool pobjeda(int polje[], int znak){ 
     if(polje[0] == znak && polje[1] == znak && polje[2] == znak || //retci
        polje[3] == znak && polje[4] == znak && polje[5] == znak ||
        polje[6] == znak && polje[7] == znak && polje[8] == znak ||
        polje[0] == znak && polje[3] == znak && polje[6] == znak || //stupci
        polje[1] == znak && polje[4] == znak && polje[7] == znak ||
        polje[2] == znak && polje[5] == znak && polje[8] == znak || 
        polje[0] == znak && polje[4] == znak && polje[8] == znak || //dijagonale
        polje[2] == znak && polje[4] == znak && polje[6] == znak){
        return true;
     }
     else{
        return false; 
     }
}

//provjerava jesu li sva polja popunjena
bool nerjeseno(int polje[]){ 
    for(int i = 0; i < 9; ++i){
        if(polje[i] == 0){
            return false;
        }
    }
    return true;
}

//provjerava uvjet za pobjedu kada bi se u polje s indeksom potez upisala oznaka igraca znak
bool provjeri_potez(int polje[], int potez, int znak){
  
  //izrada kopije polja
  int polje_kopija[9] = {};
  for(int i = 0; i < 9; ++i){
    polje_kopija[i] = polje[i]; 
  }
  
  polje_kopija[potez] = znak;

  return pobjeda(polje_kopija, znak);
}

//Provjerava hoce li nakon upisa oznake igraca znak u polje s indeskom potez postojati dvostruki nacin za povjedu
bool provjeri_dvostruki(int polje[], int potez, int znak){

   //izrada kopije polja
  int polje_kopija[9] = {};
  for(int i = 0; i < 9; ++i){
    polje_kopija[i] = polje[i]; 
  }

  int broj_pobjeda = 0;
  polje_kopija[potez] = znak;

  for(int i = 0; i < 9; ++i){
    if(polje_kopija[i] == 0 and provjeri_potez(polje_kopija, i, znak)){
         ++broj_pobjeda;
    }
  }
  if(broj_pobjeda > 1){
      return true;
  }
  else{
      return false;  
  }  
}

// odredje potez za AI
int AI_potez(int polje[]){

  //1. Ako mozes pobjediti, pobjedi
  for(int i = 0; i < 9; ++i){
    if(polje[i] == 0 && provjeri_potez(polje, i, 2 )){
        return i;
      }
  }

  //2. Ako ces izgubiti, blokiraj
  for(int i = 0; i < 9; ++i){
    if(polje[i] == 0 && provjeri_potez(polje, i, 1 )){
        return i;
      }
  }

  //3. Ako mozes napraviti dva nacina za pobijedu, napravi
  for(int i = 0; i < 9; ++i){
    if(polje[i] == 0 && provjeri_dvostruki(polje, i, 2)){
        return i;
      }
  }

  //4. Ako ce protivnik napraviti dva nacina za pobjedu, blokiraj
  //   Ako protivnik ima dva nacina za napraviti dva nacina, odustani od blokade i igraj sa strane
  int broj = 0;
  int zapamti;
  for(int i = 0; i < 9; ++i){
    if(polje[i] == 0 && provjeri_dvostruki(polje, i, 1)){
        broj += 1;
        zapamti = i;
     }
  }

  if(broj == 1){
    return zapamti;
  }
  if(broj == 2){//igraj sa strane
    for(int i = 1; i < 9; i+=2){
      if(polje[i] == 0){
          return i;
      }
    }
  }

  //5. Igraj u sredinu
  if(polje[4] == 0){
          return 4;
  }

  //6. Igraj u kut
  for(int i = 0; i < 9; i+=2){
    if(polje[i] == 0){
        return i;
    }
  }

  //7. Igraj sa strane
  for(int i = 1; i < 9; i+=2){
      if(polje[i] == 0){
          return i;
      }
   }  
}

//određuje kraj igre te ispisuje popratni tekst
bool kraj(int polje[]){
    
   if(pobjeda(polje, 1)){//nebi se nikada trebalo dogoditi
      gb.display.cursorX = 49;
      gb.display.cursorY = 10;    
      gb.display.println(F("POBJEDA!"));
      gb.display.cursorX = 49;
      gb.display.println(F("\26 Nastavi"));
      gb.display.drawBitmap(54,24,znak_O);
      return true;
      }

    if(pobjeda(polje, 2)){
      gb.display.cursorX = 49;
      gb.display.cursorY = 10;
      gb.display.println(F("PORAZ!"));
      gb.display.cursorX = 49;
      gb.display.println(F("\26 Nastavi"));
      gb.display.drawBitmap(54,24,znak_X);
      return true;
      }

    if(nerjeseno(polje)){
      gb.display.cursorX = 48;
      gb.display.cursorY = 10;
      gb.display.println(F("NERJESENO"));
      gb.display.cursorX = 49;
      gb.display.println(F("\26 Nastavi"));
      gb.display.drawBitmap(54,24,znak_O);
      gb.display.drawBitmap(54,24,znak_X);
      return true;
      }

    return false;
  
}

//početni menu koji daje izbor igraču tko će igrati prvi potez
bool izbor(){
  while (1){
    if(gb.update()){

     if(gb.buttons.pressed(BTN_A)){
        gb.sound.playOK();
        return true;
     }

     if(gb.buttons.pressed(BTN_B)){
        gb.sound.playOK();
        return false;
     }

     if(gb.buttons.pressed(BTN_C)){
        gb.sound.playCancel();
        gb.titleScreen(XO_logo);
     }
     
     gb.display.drawBitmap(0,0,mreza);
     gb.display.cursorX = 49;
     gb.display.cursorY = 10;
     gb.display.println(F("TKO IGRA"));
     gb.display.cursorX = 49;
     gb.display.println(F("PRVI ?"));
     gb.display.cursorX = 49;
     gb.display.println(F("\25 -JA"));
     gb.display.cursorX = 49;
     gb.display.cursorY = 29;
     gb.display.println(F("\26 -NE JA"));
    }  
  }
}

//menu za pokretanje nova igre ili povratak na titlescreen
void ponovno(){
  while (1){
    if(gb.update()){

     if(gb.buttons.pressed(BTN_A)){
        gb.sound.playOK();
        break;
     }

     if(gb.buttons.pressed(BTN_B)){
        gb.sound.playCancel();
        gb.titleScreen(XO_logo);
     }
     
     if(gb.buttons.pressed(BTN_C)){
        gb.sound.playCancel();
        gb.titleScreen(XO_logo);
      }

     gb.display.drawBitmap(0,0,mreza);
     gb.display.cursorX = 49;
     gb.display.cursorY = 10;
     gb.display.println(F("IGRAJ"));
     gb.display.cursorX = 49;
     gb.display.println(F("PONOVNO ?"));
     gb.display.cursorX = 49;
     gb.display.println(F("\25 - DA"));
     gb.display.cursorX = 49;
     gb.display.cursorY = 29;
     gb.display.println(F("\26 - NE"));
    }
  
  }
}

//glavna logika igre
void game(bool player_potez){

int polje[9] = {0};//polje koje pamti stanje svih pozicije na ploči (0 - prazno polje, 1 - O , 2 - X)
int pozicije[9][2] = {{2, 2}, {18, 2}, {34, 2}, //koordinate svih pozicija na ploči
                      {2, 18}, {18, 18}, {34, 18}, 
                      {2, 34}, {18, 34}, {34, 34}
                      };
                      
int selector_x = 2;//koordinate selektora polja u koje se zeli upisati znak
int selector_y = 2;

int kutevi[4] = {0, 2, 6, 8};//indeksi polja koja se nalaze u kutevima ploče, olakšava slučajan odabir jednog takvog polja

bool flash = true;//zastavica za treptanje selektora polja
bool prazno = true;//zastavica koju AI koristi za informaciju o tome je li polje za igru prazno

bool gotovo = false;//zastavica za kraj igre

while (1){//glavna petlja
    if(gb.update()){

      if(kraj(polje) && !gotovo){
      gotovo = true;
      }
      //kontrole
      //pomicanje selektora
      if(gb.buttons.pressed(BTN_UP)){
         selector_y = max(2, selector_y - 16);
      }
      if(gb.buttons.pressed(BTN_DOWN)){
        selector_y = min(34, selector_y + 16);
      }
  
      if(gb.buttons.pressed(BTN_LEFT)){
        selector_x = max(2, selector_x - 16);
      }
      
      if(gb.buttons.pressed(BTN_RIGHT)){
        selector_x = min(34, selector_x + 16);
      }
      //odabir polja za igru
      if(gb.buttons.pressed(BTN_A) && player_potez && !gotovo){
        int i = pronadi_poziciju(pozicije, selector_x, selector_y);
          if(polje[i] == 0){
            gb.sound.playOK();
            polje[i] = 1;
            player_potez = !player_potez;
            prazno = false;
         }
      }

      if(gb.buttons.pressed(BTN_B) && gotovo){
        gb.sound.playOK();
        break;
      }
   
      if(gb.buttons.pressed(BTN_C)){
        gb.sound.playCancel();
        gb.titleScreen(XO_logo);
      }
  
      //crtanje
      gb.display.drawBitmap(0,0,mreza);//mreza za igru
      for (int i = 0; i < 9; ++i){//popunjavanje mreze odigranim znakovima
        if (polje[i] == 1){
            gb.display.drawBitmap(pozicije[i][0], pozicije[i][1], znak_O);
          }
        if (polje[i] == 2){
            gb.display.drawBitmap(pozicije[i][0], pozicije[i][1], znak_X);
        }
      }
      if(flash && player_potez && !gotovo){//selektor polja
        gb.display.drawRect(selector_x - 1, selector_y - 1, 14, 14);
      }
  
      if(gb.frameCount % 5 == 0){//treptanje selektora
        flash = !flash;
      }
  
      if(!player_potez && !gotovo){
        if(prazno){//ako je ploča prazna AI igra u kut, inače sljedi algoritam napisan u funkciji AI_potez()
          polje[kutevi[random(0,4)]] = 2;
          prazno = false;
        }
        else{
          polje[AI_potez(polje)] = 2;        
        }
        gb.display.cursorX = 49;
        gb.display.cursorY = 10;
        gb.display.print(F("AI potez"));
        gb.display.drawBitmap(54,24,znak_X);
        wait(40);//čekanje kako bi se usporio AI
        gb.sound.playTick();
        player_potez = !player_potez;
        }
        
      if(player_potez && !gotovo){
        gb.display.cursorX = 52;
        gb.display.cursorY = 10;
        gb.display.println(F("Tvoj"));
        gb.display.cursorX = 52;
        gb.display.println(F("potez"));
        gb.display.drawBitmap(54,24,znak_O);
      }
    }
  }
}


// the setup routine runs once when Gamebuino starts up
void setup(){
  gb.begin();
  gb.display.drawBitmap(0,0,sino_logo);
  wait(20);
  
  gb.titleScreen(XO_logo);
  gb.pickRandomSeed();

}
// the loop routine runs over and over again forever
void loop(){
  
  game(izbor());
  ponovno();
}
